/dts-v1/;
/plugin/;
 
/{
    compatible = "brcm,bcm2712";

    fragment@0 {
        target = <&i2c1>;
        __overlay__ {
            #address-cells = <1>;
            #size-cells = <0>;
            status = "okay";
            power-sensor@40 {
                compatible = "ti,ina226";
                reg = <0x40>;
                shunt-resistor = <5000>;
            };
        };
    };
};
